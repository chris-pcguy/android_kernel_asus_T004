## drivers/misc/ami306/Kconfig
```kconfig
config MPU_SENSORS_AMI30X
	tristate "Aichi Steel ami30X"
	help
	  This enables support for the Aichi Steel ami304/ami305 compass
	  This support is for integration with the MPU3050 or MPU6050 gyroscope
	  device driver.  Only one compass can be registered at a time.
	  Specifying more that one compass in the board file will result
	  in runtime errors.
```

## drivers/sensors/Kconfig
```kconfig
config SENSORS
	bool "Sensors Class Support"
	help
	  This option enables the sensor sysfs class in /sys/class/sensors.
	  You'll need this to do anything useful with sensorss. If unsure, say N.

menu "Sensors driver"

config SENSORS_CM36283
	bool "PS ALS CM36283 support"
	default n
	---help---
	  ASUS SENSORS folder

endmenu
```
